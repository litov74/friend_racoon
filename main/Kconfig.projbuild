## main/Kconfig.projbuild
```kconfig
# Put here your custom config value

menu "Button"
    choice TIMER_IMPLEMENT
    bool "Button Timer Mode"
        default BUTTON_USE_ESP_TIMER
    help
        Choose a implementation of timer for button instance.
    config BUTTON_USE_RTOS_TIMER
        bool "Use FreeRTOS timer"
    config BUTTON_USE_ESP_TIMER
        bool "Use ESP timer"
    endchoice
    config IO_GLITCH_FILTER_TIME_MS
        int "IO glitch filter timer (10-100ms)"
        range 10 100
        default 50
endmenu
```
